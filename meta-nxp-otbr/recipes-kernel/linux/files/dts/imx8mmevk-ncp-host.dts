#include "imx8mm-evk.dts"

&ecspi2 {
   pinctrl-names = "default";
   pinctrl-0 = <&pinctrl_ecspi2 &pinctrl_ecspi2_cs &pinctrl_gpio_ncp>;
};

&uart3 {
   status = "disabled";
};

&iomuxc {
   pinctrl_gpio_ncp: gpio_ncp {
       fsl.pins = <
           MX8MM_IOMUXC_ECSPI1_SCLK_GPIO5_IO6      0x1d9
           MX8MM_IOMUXC_ECSPI1_MOSI_GPIO5_IO7      0x1d9
           MX8MM_IOMUXC_ECSPI1_MISO_GPIO5_IO8      0x1d9
           MX8MM_IOMUXC_ECSPI1_SS0_GPIO5_IO9       0x1d9
       >;
   };
};
